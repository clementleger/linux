## Documentation/devicetree/bindings/mfd/syscon-smc.yaml
```yaml
# SPDX-License-Identifier: GPL-2.0
%YAML 1.2
---
$id: http://devicetree.org/schemas/mfd/syscon-smc.yaml#
$schema: http://devicetree.org/meta-schemas/core.yaml#

title: System Controller Registers R/W via SMC Device Tree Bindings

description: |
  System controller SMC node represents a register region containing a set
  of miscellaneous registers accessed through a secure monitor. 
  The typical use-case is the same as the syscon one but when running with a
  secure monitor. 

maintainers:
  - Lee Jones <lee.jones@linaro.org>

select:
  properties:
    compatible:
      contains:
        enum:
          - syscon-smc

  required:
    - compatible

properties:
  compatible:
    enum:
      - syscon-smc

  arm,smc-id:
    $ref: /schemas/types.yaml#/definitions/uint32
    description: |
      The ATF smc function id used by the firmware.

  reg-io-width:
    description: |
      The size (in bytes) of the IO accesses that should be performed
      on the device.
    $ref: /schemas/types.yaml#/definitions/uint32
    enum: [1, 2, 4, 8]

required:
  - compatible
  - arm,smc-id

additionalProperties: false

examples:
  - |
    sfr: sfr@f8030000 {
        compatible = "atmel,sama5d2-sfr", "syscon-smc";
        arm,smc-id = <0x02000300>;
    };

...
```

## Documentation/devicetree/bindings/net/renesas,rzn1-gmac.yaml
```yaml
# SPDX-License-Identifier: (GPL-2.0-only OR BSD-2-Clause)
%YAML 1.2
---
$id: http://devicetree.org/schemas/net/renesas,rzn1-gmac.yaml#
$schema: http://devicetree.org/meta-schemas/core.yaml#

title: Renesas GMAC1 Device Tree Bindings

maintainers:
  - Clément Léger <clement.leger@bootlin.com>

select:
  properties:
    compatible:
      contains:
        enum:
          - renesas,r9a06g032-gmac
          - renesas,rzn1-gmac
  required:
    - compatible

allOf:
  - $ref: "snps,dwmac.yaml#"

properties:
  compatible:
    additionalItems: true
    maxItems: 3
    items:
      - enum:
          - renesas,r9a06g032-gmac
          - renesas,rzn1-gmac
    contains:
      enum:
        - snps,dwmac

  pcs-handle:
    description:
      phandle pointing to a PCS sub-node compatible with
      renesas,rzn1-miic.yaml#
    $ref: /schemas/types.yaml#/definitions/phandle

required:
  - compatible

unevaluatedProperties: false

examples:
  - |
    #include <dt-bindings/clock/r9a06g032-sysctrl.h>
    #include <dt-bindings/interrupt-controller/arm-gic.h>

    ethernet@44000000 {
      compatible = "renesas,rzn1-gmac";
      reg = <0x44000000 0x2000>;
      interrupt-parent = <&gic>;
      interrupts = <GIC_SPI 34 IRQ_TYPE_LEVEL_HIGH>,
             <GIC_SPI 36 IRQ_TYPE_LEVEL_HIGH>,
             <GIC_SPI 35 IRQ_TYPE_LEVEL_HIGH>;
      interrupt-names = "macirq", "eth_wake_irq", "eth_lpi";
      clock-names = "stmmaceth";
      clocks = <&sysctrl R9A06G032_HCLK_GMAC0>;
      snps,multicast-filter-bins = <256>;
      snps,perfect-filter-entries = <128>;
      tx-fifo-depth = <2048>;
      rx-fifo-depth = <4096>;
      pcs-handle = <&mii_conv1>;
      phy-mode = "mii";
    };

...
```

## Documentation/devicetree/bindings/reset/lan966x-phy,rst.yaml
```yaml
# SPDX-License-Identifier: (GPL-2.0-only OR BSD-2-Clause)
%YAML 1.2
---
$id: "http://devicetree.org/schemas/reset/lan966x-phy,rst.yaml#"
$schema: "http://devicetree.org/meta-schemas/core.yaml#"

title: Microchip Lan966x PHY Reset

maintainers:
  - Horatiu Vultur <horatiu.vultur@microchip.com>

description: |
  The Microchip Lan966x Switch provides 2 internal PHY which needs to be
  released from reset before they can be accessed. Also it might have external
  PHYs which requires to toggle a GPIO before the access to the PHYs.

properties:
  $nodename:
    pattern: "^reset-controller@[0-9a-f]+$"

  compatible:
    const: microchip,lan966x-phy-reset

  reg:
    maxItems: 1

  "#reset-cells":
    const: 1

  external-phy-reset-gpios:
    description: used for release of reset of the external PHY
    maxItems: 1

required:
  - compatible
  - reg
  - reg-names
  - "#reset-cells"

additionalProperties: false

examples:
  - |
    phy_reset: phy-reset@e2010010 {
        compatible = "microchip,lan966x-phy-reset";
        reg = <0xe2010010 0x14>;
        reg-names = "phy";
        #reset-cells = <1>;
    };
```
