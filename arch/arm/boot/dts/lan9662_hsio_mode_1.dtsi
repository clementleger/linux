// SPDX-License-Identifier: (GPL-2.0+ OR MIT)
/dts-v1/;
#include "lan966x.dtsi"

&port0 {
	phy-mode = "gmii";
	phys = <&serdes 0 CU(0)>;
};

&port1 {
	phy-mode = "gmii";
	phys = <&serdes 1 CU(1)>;
};

&port2 {
	phy-mode = "sgmii";
	phys = <&serdes 2 SERDES6G(0)>;
};

&port3 {
	phy-mode = "sgmii";
	phys = <&serdes 3 SERDES6G(1)>;
};
